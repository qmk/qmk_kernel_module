#include "dt-bindings_input.h"

/dts-v1/;
/plugin/;
/ {
    compatible = "brcm,bcm2835", "brcm,bcm2708", "brcm,bcm2709";
    
    fragment@0 {
        target-path = "/";
        __overlay__ {
            keypad: clueboard {
                compatible = "qmk";
                device-name = "Clueboard";
                debounce-delay-ms = <5>;
                // drive-inactive-cols;
                // gpio-activelow;
                col-scan-delay-us = <1000>;
                poll-interval = <2>;

                keypad,num-layers = <2>;
                keypad,num-rows = <8>;
                keypad,num-columns = <10>;
                row-gpios = <&gpio  9 0
                             &gpio  8 0
                             &gpio 24 0
                             &gpio 22 0
                             &gpio 23 0
                             &gpio 27 0
                             &gpio 17 0
                             &gpio  4 0>;
                col-gpios = <&gpio 13 0
                             &gpio 16 0
                             &gpio 19 0
                             &gpio 20 0
                             &gpio 26 0
                             &gpio  6 0
                             &gpio 12 0
                             &gpio  5 0
                             &gpio  7 0
                             &gpio 25 0>;
                qmk,keymap = <
                    // layer 0

                    LAYER_MATRIX_KEY(0, 7, 0, KC_GRAVE)
                    LAYER_MATRIX_KEY(0, 6, 0, KC_1)
                    LAYER_MATRIX_KEY(0, 5, 0, KC_2)
                    LAYER_MATRIX_KEY(0, 4, 0, KC_3)
                    LAYER_MATRIX_KEY(0, 3, 0, KC_4)
                    LAYER_MATRIX_KEY(0, 2, 0, KC_5)
                    LAYER_MATRIX_KEY(0, 1, 0, KC_6)
                    LAYER_MATRIX_KEY(0, 0, 0, KC_7)
                    LAYER_MATRIX_KEY(0, 0, 5, KC_8)
                    LAYER_MATRIX_KEY(0, 1, 5, KC_9)
                    LAYER_MATRIX_KEY(0, 2, 5, KC_0)
                    LAYER_MATRIX_KEY(0, 3, 5, KC_MINUS)
                    LAYER_MATRIX_KEY(0, 4, 5, KC_EQUAL)
                    LAYER_MATRIX_KEY(0, 5, 5, KC_BSPC)

                    LAYER_MATRIX_KEY(0, 7, 5, KC_PGUP)

                    LAYER_MATRIX_KEY(0, 7, 1, KC_TAB)
                    LAYER_MATRIX_KEY(0, 6, 1, KC_Q)
                    LAYER_MATRIX_KEY(0, 5, 1, KC_W)
                    LAYER_MATRIX_KEY(0, 4, 1, KC_E)
                    LAYER_MATRIX_KEY(0, 3, 1, KC_R)
                    LAYER_MATRIX_KEY(0, 2, 1, KC_T)
                    LAYER_MATRIX_KEY(0, 1, 1, KC_Y)
                    LAYER_MATRIX_KEY(0, 0, 1, KC_U)
                    LAYER_MATRIX_KEY(0, 0, 6, KC_I)
                    LAYER_MATRIX_KEY(0, 1, 6, KC_O)
                    LAYER_MATRIX_KEY(0, 2, 6, KC_P)
                    LAYER_MATRIX_KEY(0, 3, 6, KC_LBRC)
                    LAYER_MATRIX_KEY(0, 4, 6, KC_RBRC)
                    LAYER_MATRIX_KEY(0, 5, 6, KC_BSLS)

                    LAYER_MATRIX_KEY(0, 7, 6, KC_BSPC)

                    LAYER_MATRIX_KEY(0, 7, 2, KC_ESC)
                    LAYER_MATRIX_KEY(0, 6, 2, KC_A)
                    LAYER_MATRIX_KEY(0, 5, 2, KC_S)
                    LAYER_MATRIX_KEY(0, 4, 2, KC_D)
                    LAYER_MATRIX_KEY(0, 3, 2, KC_F)
                    LAYER_MATRIX_KEY(0, 2, 2, KC_G)
                    LAYER_MATRIX_KEY(0, 1, 2, KC_H)
                    LAYER_MATRIX_KEY(0, 0, 2, KC_J)
                    LAYER_MATRIX_KEY(0, 0, 7, KC_K)
                    LAYER_MATRIX_KEY(0, 1, 7, KC_L)
                    LAYER_MATRIX_KEY(0, 2, 7, KC_SCLN)
                    LAYER_MATRIX_KEY(0, 3, 7, KC_QUOT)
                    LAYER_MATRIX_KEY(0, 4, 7, KC_ENTER)

                    LAYER_MATRIX_KEY(0, 7, 3, KC_LSFT)
                    LAYER_MATRIX_KEY(0, 5, 3, KC_Z)
                    LAYER_MATRIX_KEY(0, 4, 3, KC_X)
                    LAYER_MATRIX_KEY(0, 3, 3, KC_C)
                    LAYER_MATRIX_KEY(0, 2, 3, KC_V)
                    LAYER_MATRIX_KEY(0, 1, 3, KC_B)
                    LAYER_MATRIX_KEY(0, 0, 3, KC_N)
                    LAYER_MATRIX_KEY(0, 0, 8, KC_M)
                    LAYER_MATRIX_KEY(0, 1, 8, KC_COMM)
                    LAYER_MATRIX_KEY(0, 2, 8, KC_DOT)
                    LAYER_MATRIX_KEY(0, 3, 8, KC_SLSH)
                    LAYER_MATRIX_KEY(0, 4, 8, KC_RSFT)
                    LAYER_MATRIX_KEY(0, 6, 8, KC_UP)

                    LAYER_MATRIX_KEY(0, 7, 4, KC_LCTL)
                    LAYER_MATRIX_KEY(0, 6, 4, KC_LALT)
                    LAYER_MATRIX_KEY(0, 5, 4, KC_LGUI)
                    LAYER_MATRIX_KEY(0, 1, 4, KC_SPACE)
                    LAYER_MATRIX_KEY(0, 2, 9, KC_RGUI)
                    LAYER_MATRIX_KEY(0, 3, 9, KC_RCTL)
                    LAYER_MATRIX_KEY(0, 4, 9, MO(1))
                    LAYER_MATRIX_KEY(0, 5, 9, KC_LEFT)
                    LAYER_MATRIX_KEY(0, 6, 9, KC_DOWN)
                    LAYER_MATRIX_KEY(0, 7, 9, KC_RIGHT)
                >;
            };
        };
    };
};  
