#include "dt-bindings_input.h"

/dts-v1/;
/plugin/;
/ {
    compatible = "brcm,bcm2835", "brcm,bcm2708", "brcm,bcm2709";
    
    fragment@0 {
        target-path = "/";
        __overlay__ {
            keypad: planck {
                compatible = "qmk";
                device-name = "Planck Keyboard";
                debounce-delay-ms = <5>;
                // drive-inactive-cols;
                // gpio-activelow;
                col-scan-delay-us = <1000>;
                poll-interval = <2>;
                
                qmk,encoder-gpios = <&gpio 5 0
                                     &gpio 7 0
                                     &gpio 8 0>;
                qmk,encoder-keys = <KC_VOLU KC_VOLD>;

                keypad,num-layers = <3>;
                keypad,num-columns = <6>;
                keypad,num-rows = <8>;
                col-gpios = <&gpio 20 0
                             &gpio 21 0
                             &gpio 6  0
                             &gpio 24 0
                             &gpio 23 0
                             &gpio 22 0>;
                row-gpios = <&gpio 12 0
                             &gpio 13 0
                             &gpio 16 0
                             &gpio 19 0
                             &gpio 25 0
                             &gpio 10 0
                             &gpio 9  0
                             &gpio 11 0>;
                qmk,keymap = <
                    // layer 0

                    LAYER_MATRIX_KEY(0, 0, 0, KC_TAB)
                    LAYER_MATRIX_KEY(0, 0, 1, KC_Q)
                    LAYER_MATRIX_KEY(0, 0, 2, KC_W)
                    LAYER_MATRIX_KEY(0, 0, 3, KC_F)
                    LAYER_MATRIX_KEY(0, 0, 4, KC_P)
                    LAYER_MATRIX_KEY(0, 0, 5, KC_G)
                    LAYER_MATRIX_KEY(0, 4, 0, KC_J)
                    LAYER_MATRIX_KEY(0, 4, 1, KC_L)
                    LAYER_MATRIX_KEY(0, 4, 2, KC_U)
                    LAYER_MATRIX_KEY(0, 4, 3, KC_Y)
                    LAYER_MATRIX_KEY(0, 4, 4, KC_SCLN)
                    LAYER_MATRIX_KEY(0, 4, 5, KC_BSPC)

                    LAYER_MATRIX_KEY(0, 1, 0, KC_ESC)
                    LAYER_MATRIX_KEY(0, 1, 1, KC_A)
                    LAYER_MATRIX_KEY(0, 1, 2, KC_R)
                    LAYER_MATRIX_KEY(0, 1, 3, KC_S)
                    LAYER_MATRIX_KEY(0, 1, 4, KC_T)
                    LAYER_MATRIX_KEY(0, 1, 5, KC_D)
                    LAYER_MATRIX_KEY(0, 5, 0, KC_H)
                    LAYER_MATRIX_KEY(0, 5, 1, KC_N)
                    LAYER_MATRIX_KEY(0, 5, 2, KC_E)
                    LAYER_MATRIX_KEY(0, 5, 3, KC_I)
                    LAYER_MATRIX_KEY(0, 5, 4, KC_O)
                    LAYER_MATRIX_KEY(0, 5, 5, KC_QUOT)

                    LAYER_MATRIX_KEY(0, 2, 0, KC_LSFT)
                    LAYER_MATRIX_KEY(0, 2, 1, KC_Z)
                    LAYER_MATRIX_KEY(0, 2, 2, KC_X)
                    LAYER_MATRIX_KEY(0, 2, 3, KC_C)
                    LAYER_MATRIX_KEY(0, 2, 4, KC_V)
                    LAYER_MATRIX_KEY(0, 2, 5, KC_B)
                    LAYER_MATRIX_KEY(0, 6, 0, KC_K)
                    LAYER_MATRIX_KEY(0, 6, 1, KC_M)
                    LAYER_MATRIX_KEY(0, 6, 2, KC_COMM)
                    LAYER_MATRIX_KEY(0, 6, 3, KC_DOT)
                    LAYER_MATRIX_KEY(0, 6, 4, KC_SLSH)
                    LAYER_MATRIX_KEY(0, 6, 5, KC_ENT)

                    LAYER_MATRIX_KEY(0, 3, 0, KC_RSFT)
                    LAYER_MATRIX_KEY(0, 3, 1, KC_LGUI)
                    LAYER_MATRIX_KEY(0, 3, 2, KC_LALT)
                    LAYER_MATRIX_KEY(0, 7, 3, KC_LCTL)
                    LAYER_MATRIX_KEY(0, 7, 4, MO(1))
                    LAYER_MATRIX_KEY(0, 7, 5, KC_SPACE)
                    LAYER_MATRIX_KEY(0, 7, 0, KC_SPACE) // space
                    LAYER_MATRIX_KEY(0, 7, 1, MO(2))
                    LAYER_MATRIX_KEY(0, 7, 2, KC_LEFT)
                    LAYER_MATRIX_KEY(0, 3, 3, KC_DOWN)
                    LAYER_MATRIX_KEY(0, 3, 4, KC_UP)
                    LAYER_MATRIX_KEY(0, 3, 5, KC_RIGHT)

                    // layer 1

                    LAYER_MATRIX_KEY(1, 0, 0, S(KC_GRAVE))
                    LAYER_MATRIX_KEY(1, 0, 1, S(KC_1))
                    LAYER_MATRIX_KEY(1, 0, 2, S(KC_2))
                    LAYER_MATRIX_KEY(1, 0, 3, S(KC_3))
                    LAYER_MATRIX_KEY(1, 0, 4, S(KC_4))
                    LAYER_MATRIX_KEY(1, 0, 5, S(KC_5))
                    LAYER_MATRIX_KEY(1, 4, 0, S(KC_6))
                    LAYER_MATRIX_KEY(1, 4, 1, S(KC_7))
                    LAYER_MATRIX_KEY(1, 4, 2, S(KC_8))
                    LAYER_MATRIX_KEY(1, 4, 3, S(KC_9))
                    LAYER_MATRIX_KEY(1, 4, 4, S(KC_0))
                    LAYER_MATRIX_KEY(1, 4, 5, KC_BSPC)

                    LAYER_MATRIX_KEY(1, 1, 0, KC_DEL)
                    LAYER_MATRIX_KEY(1, 1, 1, KC_A)
                    LAYER_MATRIX_KEY(1, 1, 2, KC_S)
                    LAYER_MATRIX_KEY(1, 1, 3, KC_D)
                    LAYER_MATRIX_KEY(1, 1, 4, KC_F)
                    LAYER_MATRIX_KEY(1, 1, 5, KC_G)
                    LAYER_MATRIX_KEY(1, 5, 0, KC_H)
                    LAYER_MATRIX_KEY(1, 5, 1, S(KC_MINS))
                    LAYER_MATRIX_KEY(1, 5, 2, S(KC_EQL))
                    LAYER_MATRIX_KEY(1, 5, 3, S(KC_LBRC))
                    LAYER_MATRIX_KEY(1, 5, 4, S(KC_RBRC))
                    LAYER_MATRIX_KEY(1, 5, 5, S(KC_BSLS))

                    LAYER_MATRIX_KEY(1, 2, 0, KC_LSFT)
                    LAYER_MATRIX_KEY(1, 2, 1, KC_Z)
                    LAYER_MATRIX_KEY(1, 2, 2, KC_X)
                    LAYER_MATRIX_KEY(1, 2, 3, KC_C)
                    LAYER_MATRIX_KEY(1, 2, 4, KC_V)
                    LAYER_MATRIX_KEY(1, 2, 5, KC_B)
                    LAYER_MATRIX_KEY(1, 6, 0, KC_N)
                    LAYER_MATRIX_KEY(1, 6, 1, KC_M)
                    LAYER_MATRIX_KEY(1, 6, 2, KC_COMMA)
                    LAYER_MATRIX_KEY(1, 6, 3, KC_DOT)
                    LAYER_MATRIX_KEY(1, 6, 4, KC_SLSH)
                    LAYER_MATRIX_KEY(1, 6, 5, KC_ENT)

                    LAYER_MATRIX_KEY(1, 3, 0, KC_RSFT)
                    LAYER_MATRIX_KEY(1, 3, 1, KC_LGUI)
                    LAYER_MATRIX_KEY(1, 3, 2, KC_LALT)
                    LAYER_MATRIX_KEY(1, 7, 3, KC_LCTL)
                    LAYER_MATRIX_KEY(1, 7, 4, MO(1))
                    LAYER_MATRIX_KEY(1, 7, 5, KC_SPACE)
                    LAYER_MATRIX_KEY(1, 7, 0, KC_SPACE) // space
                    LAYER_MATRIX_KEY(1, 7, 1, MO(2))
                    LAYER_MATRIX_KEY(1, 7, 2, KC_LEFT)
                    LAYER_MATRIX_KEY(1, 3, 3, KC_DOWN)
                    LAYER_MATRIX_KEY(1, 3, 4, KC_UP)
                    LAYER_MATRIX_KEY(1, 3, 5, KC_RIGHT)

                    // layer 2

                    LAYER_MATRIX_KEY(2, 0, 0, KC_GRAVE)
                    LAYER_MATRIX_KEY(2, 0, 1, KC_1)
                    LAYER_MATRIX_KEY(2, 0, 2, KC_2)
                    LAYER_MATRIX_KEY(2, 0, 3, KC_3)
                    LAYER_MATRIX_KEY(2, 0, 4, KC_4)
                    LAYER_MATRIX_KEY(2, 0, 5, KC_5)
                    LAYER_MATRIX_KEY(2, 4, 0, KC_6)
                    LAYER_MATRIX_KEY(2, 4, 1, KC_7)
                    LAYER_MATRIX_KEY(2, 4, 2, KC_8)
                    LAYER_MATRIX_KEY(2, 4, 3, KC_9)
                    LAYER_MATRIX_KEY(2, 4, 4, KC_0)
                    LAYER_MATRIX_KEY(2, 4, 5, KC_BSPC)

                    LAYER_MATRIX_KEY(2, 1, 0, KC_DEL)
                    LAYER_MATRIX_KEY(2, 1, 1, KC_A)
                    LAYER_MATRIX_KEY(2, 1, 2, KC_S)
                    LAYER_MATRIX_KEY(2, 1, 3, KC_D)
                    LAYER_MATRIX_KEY(2, 1, 4, KC_F)
                    LAYER_MATRIX_KEY(2, 1, 5, KC_G)
                    LAYER_MATRIX_KEY(2, 5, 0, KC_H)
                    LAYER_MATRIX_KEY(2, 5, 1, KC_MINS)
                    LAYER_MATRIX_KEY(2, 5, 2, KC_EQL)
                    LAYER_MATRIX_KEY(2, 5, 3, KC_LBRC)
                    LAYER_MATRIX_KEY(2, 5, 4, KC_RBRC)
                    LAYER_MATRIX_KEY(2, 5, 5, KC_BSLS)

                    LAYER_MATRIX_KEY(2, 2, 0, KC_LSFT)
                    LAYER_MATRIX_KEY(2, 2, 1, KC_Z)
                    LAYER_MATRIX_KEY(2, 2, 2, KC_X)
                    LAYER_MATRIX_KEY(2, 2, 3, KC_C)
                    LAYER_MATRIX_KEY(2, 2, 4, KC_V)
                    LAYER_MATRIX_KEY(2, 2, 5, KC_B)
                    LAYER_MATRIX_KEY(2, 6, 0, KC_N)
                    LAYER_MATRIX_KEY(2, 6, 1, 0xFFF1)
                    LAYER_MATRIX_KEY(2, 6, 2, KC_COMM)
                    LAYER_MATRIX_KEY(2, 6, 3, KC_DOT)
                    LAYER_MATRIX_KEY(2, 6, 4, KC_SLSH)
                    LAYER_MATRIX_KEY(2, 6, 5, KC_ENT)

                    LAYER_MATRIX_KEY(2, 3, 0, KC_RSFT)
                    LAYER_MATRIX_KEY(2, 3, 1, KC_LGUI)
                    LAYER_MATRIX_KEY(2, 3, 2, KC_LALT)
                    LAYER_MATRIX_KEY(2, 7, 3, KC_LCTL)
                    LAYER_MATRIX_KEY(2, 7, 4, MO(1))
                    LAYER_MATRIX_KEY(2, 7, 5, KC_SPACE)
                    LAYER_MATRIX_KEY(2, 7, 0, KC_SPACE) // space
                    LAYER_MATRIX_KEY(2, 7, 1, MO(2))
                    LAYER_MATRIX_KEY(2, 7, 2, KC_LEFT)
                    LAYER_MATRIX_KEY(2, 3, 3, KC_DOWN)
                    LAYER_MATRIX_KEY(2, 3, 4, KC_UP)
                    LAYER_MATRIX_KEY(2, 3, 5, KC_RIGHT)
                >;
            };
        };
    };
};  
